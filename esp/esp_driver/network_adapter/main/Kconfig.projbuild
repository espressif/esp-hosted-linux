## esp/esp_driver/network_adapter/main/Kconfig.projbuild
```kconfig
menu "Example Configuration"

    choice ESP_HOST_INTERFACE
        bool "Transport layer"
        default ESP_USB_HOST_INTERFACE if IDF_TARGET_ESP32S31
        default ESP_SDIO_HOST_INTERFACE if SOC_SDIO_SLAVE_SUPPORTED
        default ESP_SPI_HOST_INTERFACE
        help
            Bus interface to be used for communication with the host

        config ESP_SDIO_HOST_INTERFACE
            bool "SDIO interface"
            depends on SOC_SDIO_SLAVE_SUPPORTED
            help
                Enable/Disable SDIO host interface

        config ESP_SPI_HOST_INTERFACE
            bool "SPI interface"
            help
                Enable/Disable SPI host interface

        config ESP_USB_HOST_INTERFACE
            bool "USB interface"
            depends on IDF_TARGET_ESP32S31
            help
                Enable ESP32-S31 high-speed USB vendor bulk transport
    endchoice

    menu "SPI Configuration"
        depends on ESP_SPI_HOST_INTERFACE

    config ESP_SPI_CONTROLLER
        int "SPI controller to use"
        depends on IDF_TARGET_ESP32 && ESP_SPI_HOST_INTERFACE
        default 2
	range 2 3
        help
            SPI controller to be used. HSPI->2, VSPI->3

    config ESP_SPI_GPIO_HANDSHAKE
        int "GPIO pin for handshake"
        default 3 if IDF_TARGET_ESP32C2
        default 3 if IDF_TARGET_ESP32C3
        default 3 if IDF_TARGET_ESP32C6
        default 3 if IDF_TARGET_ESP32C61
        default 3 if IDF_TARGET_ESP32C5
        default 3 if IDF_TARGET_ESP32S31
        default 2
        help
            GPIO pin to use for handshake with other spi controller

    config ESP_SPI_GPIO_DATA_READY
        int "GPIO pin for data ready interrupt"
        default 4
        help
            GPIO pin for indicating host that SPI slave has data to be read by host

    config ESP_SPI_TX_Q_SIZE
        int "ESP to Host SPI queue size"
        default 10 if IDF_TARGET_ESP32
        default 20
        help
            Very small tx queue will lower ESP == SPI ==> Host data rate

    config ESP_SPI_RX_Q_SIZE
        int "Host to ESP SPI queue size"
        default 10 if IDF_TARGET_ESP32
        default 20
        help
            Very small RX queue will lower ESP <== SPI == Host data rate

    config ESP_SPI_CHECKSUM
        bool "SPI checksum ENABLE/DISABLE"
        default y
        help
            ENABLE/DISABLE software SPI checksum

    config ESP_SPI_DEASSERT_HS_ON_CS
        bool "De-assert HS on CS"
        default n
        help
            De-assert HS signal on CS, instead of at end of transaction.
            This is useful for some hosts that have a delay in de-asserting CS.
    endmenu

    menu "SDIO Configuration"
        depends on ESP_SDIO_HOST_INTERFACE

    config ESP_SDIO_CHECKSUM
        bool "SDIO checksum ENABLE/DISABLE"
        default n
        help
            ENABLE/DISABLE software SDIO checksum

    endmenu

    config HOST_WAKEUP_GPIO
        int "GPIO to wakeup GPIO"
        depends on ESP_SDIO_HOST_INTERFACE
        default 22 if IDF_TARGET_ESP32
        default 4 if IDF_TARGET_ESP32C6
        default 5 if IDF_TARGET_ESP32C5
        default 5 if IDF_TARGET_ESP32C61
        help
            GPIO pin used to wake-up host

    config SDIO_CARD_DETECTION_PIN_SUPPORT
        bool "SDIO CD Pin support"
        default n
        help
            Some hosts' implementations may require an additional signal by firmware
            to indicate that it's ready for communication. This config option enables
            support for that extra signal. GPIO pin number can be configured using SDIO_CD_PIN_GPIO.

    config SDIO_CD_PIN_GPIO
        int "CD Pin GPIO"
        depends on ESP_SDIO_HOST_INTERFACE
        depends on SDIO_CARD_DETECTION_PIN_SUPPORT
        default 6
        help
            Some hosts' implementations may require an additional signal by firmware
            to indicate that it's ready for communication. This GPIO pin used to indicate
            host that card is ready for communication.

    choice SDIO_SLAVE_SPEED
        prompt "SDIO slave speed"
        depends on ESP_SDIO_HOST_INTERFACE
        default SDIO_HIGH_SPEED
        help
            SDIO slave speed, could be either default speed or high speed.
            Enabling this will cause the host to see highspeed capability.

        config SDIO_DEFAULT_SPEED
            bool "Default Speed"

        config SDIO_HIGH_SPEED
            bool "High Speed"
    endchoice

    config ESP_OTA_WORKAROUND
        bool "OTA workaround - Add sleeps while OTA write"
        default y
        help
            Enable/disable sleeps while OTA operations

    config ESP_HOSTED_RCP
        bool "IEEE 802.15.4 RCP byte stream over ESP-Hosted"
        depends on SOC_IEEE802154_SUPPORTED
        default y if IDF_TARGET_ESP32S31
        default n
        help
            Add a stack-agnostic Spinel/HDLC byte-stream channel over the
            selected ESP-Hosted SDIO/SPI/USB transport. This is the preferred
            ESP32-S31 product transport whenever ESP-Hosted is used: it reuses
            the existing framed, flow-controlled host bus and avoids a separate
            UART integration. Dedicated Thread UART RCP remains available as an
            explicit opt-in for products that intentionally keep radio host
            interfaces physically separate.

    config ESP_HOSTED_RCP_LOOPBACK_TEST
        bool "RCP transport loopback test backend"
        depends on ESP_HOSTED_RCP
        default n
        help
            Echo Host-to-ESP RCP bytes back to the host instead of passing
            them to a radio backend. Test-only; validates the Hosted byte
            stream over SDIO/SPI/USB without an ESP-IDF custom RCP transport.

    config ESP_HOSTED_RCP_LOOPBACK_DELAY_MS
        int "RCP loopback response delay (test only)"
        depends on ESP_HOSTED_RCP_LOOPBACK_TEST
        range 0 1000
        default 0
        help
            Delay each loopback response to exercise close/reopen session
            boundaries with a deterministic late firmware response. This has
            no effect unless the test-only loopback backend is enabled.

    config ESP_HOSTED_RCP_OPENTHREAD
        bool "Bind Hosted RCP stream to ESP-IDF OpenThread RCP"
        depends on ESP_HOSTED_RCP && !ESP_HOSTED_RCP_LOOPBACK_TEST
        depends on OPENTHREAD_ENABLED && OPENTHREAD_RADIO && OPENTHREAD_RCP_CUSTOM
        default y
        help
            Run the ESP-IDF OpenThread radio co-processor on the native
            IEEE 802.15.4 radio and carry its HDLC-framed Spinel stream over
            ESP_RCP_IF. Thread/Zigbee policy remains on the host.

    config ESP_HOSTED_RCP_RX_QUEUE_SIZE
        int "RCP Host-to-ESP queued chunks"
        depends on ESP_HOSTED_RCP
        range 4 64
        default 16
        help
            Number of complete Hosted RCP chunks buffered for the RCP backend.
            Overflow is session-fatal rather than silently dropping Spinel bytes.

    config ESP_THREAD_RCP_UART
        bool "Expose OpenThread RCP over a dedicated UART (explicit opt-in)"
        depends on IDF_TARGET_ESP32S31 && SOC_IEEE802154_SUPPORTED
        depends on OPENTHREAD_ENABLED && OPENTHREAD_RADIO && OPENTHREAD_RCP_UART
        depends on !ESP_HOSTED_RCP
        default n
        help
            Start the native IEEE 802.15.4 OpenThread RCP on a UART that is
            independent of ESP-Hosted. Prefer ESP_HOSTED_RCP when SDIO/SPI/USB
            is available. Enable this only when the customer intentionally
            requires a physically separate Thread interface (or does not use
            an ESP-Hosted RCP path). Select OPENTHREAD_RCP_UART instead of
            OPENTHREAD_RCP_CUSTOM before enabling this option.

    config ESP_THREAD_RCP_UART_PORT
        int "Dedicated Thread RCP UART port"
        depends on ESP_THREAD_RCP_UART
        range 0 3
        default 2
        help
            ESP32-S31 high-performance UART used for Thread Spinel. UART2 is
            the default so Bluetooth HCI can independently use UART1.

    config ESP_THREAD_RCP_UART_BAUD
        int "Dedicated Thread RCP UART baud rate"
        depends on ESP_THREAD_RCP_UART
        range 115200 5000000
        default 460800

    config ESP_THREAD_RCP_UART_TX_PIN
        int "Dedicated Thread RCP UART TX GPIO"
        depends on ESP_THREAD_RCP_UART
        range -1 61
        default -1
        help
            GPIO routed to Thread RCP UART TX. -1 keeps the UART's existing
            pin routing.

    config ESP_THREAD_RCP_UART_RX_PIN
        int "Dedicated Thread RCP UART RX GPIO"
        depends on ESP_THREAD_RCP_UART
        range -1 61
        default -1
        help
            GPIO routed to Thread RCP UART RX. -1 keeps the UART's existing
            pin routing.

    config ESP_SERIAL_DEBUG
        bool "Debug Serial driver data path"
        default 0
        help
            Enable/disable debug prints in serial driver data path

    config ESP_WLAN_DEBUG
        bool "Debug Wlan driver data path"
        default 0
        help
            Enable/disable debug prints in wlan driver data path

    config ESP_BT_DEBUG
        bool "Debug Bluetooth driver data path"
        default 0
        help
            Enable/disable debug prints in Bluetooth driver data path

    config EXAMPLE_HCI_UART_BAUDRATE
        int "UART Baudrate for HCI"
        range 115200 921600
        depends on IDF_TARGET_ESP32C3 || IDF_TARGET_ESP32S3 || IDF_TARGET_ESP32C2 || IDF_TARGET_ESP32C5 || IDF_TARGET_ESP32C6 || IDF_TARGET_ESP32C61
        default 921600
        help
            UART Baudrate for HCI. Please use standard baudrate.

endmenu
```

## esp/esp_driver/network_adapter/sdkconfig.defaults
```kconfig
CONFIG_ESP32_DEFAULT_CPU_FREQ_160=y
CONFIG_ESP32_DEFAULT_CPU_FREQ_MHZ=160
CONFIG_SDIO_DAT2_DISABLED=

# BT Configuration
CONFIG_BT_ENABLED=y
CONFIG_BT_CONTROLLER_ONLY=y
CONFIG_BT_BLUEDROID_ENABLED=
CONFIG_BTDM_CTRL_MODE_BTDM=y
CONFIG_BTDM_CTRL_HCI_MODE_VHCI=y

CONFIG_ESP32_WIFI_NVS_ENABLED=
# OTA
CONFIG_ESPTOOLPY_FLASHSIZE_4MB=y
CONFIG_PARTITION_TABLE_TWO_OTA=y
CONFIG_FREERTOS_HZ=1000
CONFIG_ESP_WIFI_IRAM_OPT=n

# Size, not debug: app is -Os. Bootloader/mbedTLS already use SIZE.
CONFIG_COMPILER_OPTIMIZATION_SIZE=y
CONFIG_ESP_WIFI_ENABLE_SAE_PK=n
CONFIG_ESP_WIFI_ENABLE_WPA3_SAE=n
CONFIG_ESP_WIFI_ENABLE_WPA3_OWE_STA=n
CONFIG_ESP_WIFI_ENABLE_WPA3_OWE_SOFTAP=n
CONFIG_ESP_WIFI_ENTERPRISE_SUPPORT=n
CONFIG_ESP_WIFI_GCMP_SUPPORT=y
```

## esp/esp_driver/network_adapter/sdkconfig.defaults.esp32s31_usb
```kconfig
# ESP32-S31 USB transport overlay
# Layer after sdkconfig.defaults and sdkconfig.defaults.esp32s31.

CONFIG_ESP_USB_HOST_INTERFACE=y
CONFIG_TINYUSB_VENDOR_COUNT=1
CONFIG_TINYUSB_VENDOR_RX_BUFSIZE=8192
CONFIG_TINYUSB_VENDOR_TX_BUFSIZE=16384
```
